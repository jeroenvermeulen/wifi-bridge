## src/Kconfig.projbuild
```kconfig
menu "WiFi bridge board"

    comment "Ethernet chip and wiring. Each board sets these in boards/<board>.defaults"

    choice BRIDGE_ETH_CHIP
        prompt "Ethernet chip"
        default BRIDGE_ETH_W5500

        config BRIDGE_ETH_W5500
            bool "W5500"
        config BRIDGE_ETH_W5100
            bool "W5100"
            help
                E.g. the Arduino Ethernet Shield. Its SPI moves one byte per
                4-byte frame, and it can't report the link state, so the bridge
                treats the link as always up. It always autonegotiates: leave
                BRIDGE_ETH_AUTONEGOTIATE on.
    endchoice

    config BRIDGE_PIN_MOSI
        int "Ethernet chip MOSI GPIO"
        default -1

    config BRIDGE_PIN_MISO
        int "Ethernet chip MISO GPIO"
        default -1

    config BRIDGE_PIN_SCLK
        int "Ethernet chip SCLK GPIO"
        default -1

    config BRIDGE_PIN_CS
        int "Ethernet chip CS GPIO"
        default -1

    config BRIDGE_PIN_INT
        int "Ethernet chip INT GPIO (-1: not connected, poll instead)"
        default -1

    config BRIDGE_PIN_RST
        int "Ethernet chip RST GPIO (-1: not connected)"
        default -1

    config BRIDGE_SPI_MHZ
        int "Ethernet chip SPI clock (MHz)"
        range 1 80
        default 20
        help
            Rounded down to 80 MHz divided by an integer (40, 26, 20, ...).
            Above 26 MHz the pins must be the SPI2 IO_MUX pins. The W5100
            is rated for 14 MHz.

    config BRIDGE_ETH_AUTONEGOTIATE
        bool "Autonegotiate Ethernet speed and duplex"
        default y
        help
            Turn off to force the link mode below, for boards whose W5500
            can't hold the speed it negotiates. Not supported by the W5100.

    choice BRIDGE_ETH_SPEED
        prompt "Forced Ethernet speed"
        depends on !BRIDGE_ETH_AUTONEGOTIATE
        default BRIDGE_ETH_SPEED_10M

        config BRIDGE_ETH_SPEED_10M
            bool "10 Mbit"
        config BRIDGE_ETH_SPEED_100M
            bool "100 Mbit"
    endchoice

    choice BRIDGE_ETH_DUPLEX
        prompt "Forced Ethernet duplex"
        depends on !BRIDGE_ETH_AUTONEGOTIATE
        default BRIDGE_ETH_DUPLEX_FULL
        help
            Must match the wired device. An autonegotiating device falls back
            to half duplex against a forced link, but some (e.g. Realtek USB
            2.5G adapters) only do full. A mismatch shows up as slow
            WiFi -> Ethernet throughput.

        config BRIDGE_ETH_DUPLEX_HALF
            bool "Half duplex"
        config BRIDGE_ETH_DUPLEX_FULL
            bool "Full duplex"
    endchoice

    config BRIDGE_WIFI_MAX_TX_POWER
        int "WiFi max TX power in 0.25 dBm units (0: chip default)"
        range 0 84
        default 0
        help
            Some boards transmit badly at full power because of their antenna
            or power supply, e.g. the LOLIN S2 Mini works best at 34 (8.5 dBm).

endmenu
```
